## samples/zephyr_OT_pq_edhoc/responder/Kconfig
```kconfig
# Config options for OpenThread Border CoAP sample app

# Copyright (c) 2024 Alexandre Bailon
# SPDX-License-Identifier: Apache-2.0

mainmenu "OpenThread CoAP Sample"

menu "Application configuration"

config OT_COAP_SAMPLE_CLIENT
    bool "Build the sample CoAP client application"
    default n

config OT_COAP_SAMPLE_SERVER
    bool "Build the sample CoAP server application"
    default y

endmenu

source "Kconfig.zephyr"
```

## samples/zephyr_OT_pq_edhoc_KEM/initiator/Kconfig
```kconfig
# Config options for OpenThread Border CoAP sample app

# Copyright (c) 2024 Alexandre Bailon
# SPDX-License-Identifier: Apache-2.0

mainmenu "OpenThread CoAP Sample"

menu "Application configuration"

config OT_COAP_SAMPLE_CLIENT
    bool "Build the sample CoAP client application"
    default y

config OT_COAP_SAMPLE_SERVER
    bool "Build the sample CoAP server application"
    default n

endmenu

source "Kconfig.zephyr"
```

## samples/zephyr_OT_pq_edhoc_KEM/initiator/build_falcon_board/Kconfig/Kconfig.modules
```kconfig
menu "acpica (/home/panosalex/zephyr_v4.2.2/modules/lib/acpica)"
osource "$(ZEPHYR_ACPICA_KCONFIG)"
config ZEPHYR_ACPICA_MODULE
	bool
	default y
endmenu
menu "cmsis (/home/panosalex/zephyr_v4.2.2/modules/hal/cmsis)"
osource "$(ZEPHYR_CMSIS_KCONFIG)"
config ZEPHYR_CMSIS_MODULE
	bool
	default y
endmenu
menu "cmsis-dsp (/home/panosalex/zephyr_v4.2.2/modules/lib/cmsis-dsp)"
osource "$(ZEPHYR_CMSIS_DSP_KCONFIG)"
config ZEPHYR_CMSIS_DSP_MODULE
	bool
	default y
endmenu
menu "cmsis-nn (/home/panosalex/zephyr_v4.2.2/modules/lib/cmsis-nn)"
osource "$(ZEPHYR_CMSIS_NN_KCONFIG)"
config ZEPHYR_CMSIS_NN_MODULE
	bool
	default y
endmenu
menu "cmsis_6 (/home/panosalex/zephyr_v4.2.2/modules/hal/cmsis_6)"
osource "$(ZEPHYR_CMSIS_6_KCONFIG)"
config ZEPHYR_CMSIS_6_MODULE
	bool
	default y
endmenu
menu "fatfs (/home/panosalex/zephyr_v4.2.2/modules/fs/fatfs)"
osource "$(ZEPHYR_FATFS_KCONFIG)"
config ZEPHYR_FATFS_MODULE
	bool
	default y
endmenu
config ZEPHYR_ADI_MODULE
	bool
	default y
menu "hal_afbr (/home/panosalex/zephyr_v4.2.2/modules/hal/afbr)"
osource "$(ZEPHYR_HAL_AFBR_KCONFIG)"
config ZEPHYR_HAL_AFBR_MODULE
	bool
	default y

config ZEPHYR_HAL_AFBR_MODULE_BLOBS
	bool
endmenu
menu "hal_ambiq (/home/panosalex/zephyr_v4.2.2/modules/hal/ambiq)"
osource "$(ZEPHYR_HAL_AMBIQ_KCONFIG)"
config ZEPHYR_HAL_AMBIQ_MODULE
	bool
	default y
endmenu
config ZEPHYR_ATMEL_MODULE
	bool
	default y
menu "hal_bouffalolab (/home/panosalex/zephyr_v4.2.2/modules/hal/bouffalolab)"
osource "$(ZEPHYR_HAL_BOUFFALOLAB_KCONFIG)"
config ZEPHYR_HAL_BOUFFALOLAB_MODULE
	bool
	default y
endmenu
menu "hal_espressif (/home/panosalex/zephyr_v4.2.2/modules/hal/espressif)"
osource "/home/panosalex/zephyr_v4.2.2/modules/hal/espressif/zephyr/Kconfig"
config ZEPHYR_HAL_ESPRESSIF_MODULE
	bool
	default y

config ZEPHYR_HAL_ESPRESSIF_MODULE_BLOBS
	bool
endmenu
menu "hal_ethos_u (/home/panosalex/zephyr_v4.2.2/modules/hal/ethos_u)"
osource "$(ZEPHYR_HAL_ETHOS_U_KCONFIG)"
config ZEPHYR_HAL_ETHOS_U_MODULE
	bool
	default y
endmenu
menu "hal_gigadevice (/home/panosalex/zephyr_v4.2.2/modules/hal/gigadevice)"
osource "$(ZEPHYR_HAL_GIGADEVICE_KCONFIG)"
config ZEPHYR_HAL_GIGADEVICE_MODULE
	bool
	default y
endmenu
menu "hal_infineon (/home/panosalex/zephyr_v4.2.2/modules/hal/infineon)"
osource "$(ZEPHYR_HAL_INFINEON_KCONFIG)"
config ZEPHYR_HAL_INFINEON_MODULE
	bool
	default y

config ZEPHYR_HAL_INFINEON_MODULE_BLOBS
	bool
endmenu
menu "hal_intel (/home/panosalex/zephyr_v4.2.2/modules/hal/intel)"
osource "/home/panosalex/zephyr_v4.2.2/modules/hal/intel/zephyr/Kconfig"
config ZEPHYR_HAL_INTEL_MODULE
	bool
	default y
endmenu
config ZEPHYR_MICROCHIP_MODULE
	bool
	default y
menu "hal_nordic (/home/panosalex/zephyr_v4.2.2/modules/hal/nordic)"
osource "$(ZEPHYR_HAL_NORDIC_KCONFIG)"
config ZEPHYR_HAL_NORDIC_MODULE
	bool
	default y

config ZEPHYR_HAL_NORDIC_MODULE_BLOBS
	bool
endmenu
config ZEPHYR_NUVOTON_MODULE
	bool
	default y
menu "hal_nxp (/home/panosalex/zephyr_v4.2.2/modules/hal/nxp)"
osource "$(ZEPHYR_HAL_NXP_KCONFIG)"
config ZEPHYR_HAL_NXP_MODULE
	bool
	default y

config ZEPHYR_HAL_NXP_MODULE_BLOBS
	bool
endmenu
config ZEPHYR_OPENISA_MODULE
	bool
	default y
config ZEPHYR_QUICKLOGIC_MODULE
	bool
	default y
config ZEPHYR_HAL_RENESAS_MODULE
	bool
	default y

config ZEPHYR_HAL_RENESAS_MODULE_BLOBS
	bool
menu "hal_rpi_pico (/home/panosalex/zephyr_v4.2.2/modules/hal/rpi_pico)"
osource "$(ZEPHYR_HAL_RPI_PICO_KCONFIG)"
config ZEPHYR_HAL_RPI_PICO_MODULE
	bool
	default y
endmenu
menu "hal_silabs (/home/panosalex/zephyr_v4.2.2/modules/hal/silabs)"
osource "$(ZEPHYR_HAL_SILABS_KCONFIG)"
config ZEPHYR_HAL_SILABS_MODULE
	bool
	default y

config ZEPHYR_HAL_SILABS_MODULE_BLOBS
	bool
endmenu
menu "hal_st (/home/panosalex/zephyr_v4.2.2/modules/hal/st)"
osource "$(ZEPHYR_HAL_ST_KCONFIG)"
config ZEPHYR_HAL_ST_MODULE
	bool
	default y
endmenu
config ZEPHYR_HAL_STM32_MODULE
	bool
	default y

config ZEPHYR_HAL_STM32_MODULE_BLOBS
	bool
menu "hal_tdk (/home/panosalex/zephyr_v4.2.2/modules/hal/tdk)"
osource "$(ZEPHYR_HAL_TDK_KCONFIG)"
config ZEPHYR_HAL_TDK_MODULE
	bool
	default y
endmenu
menu "hal_telink (/home/panosalex/zephyr_v4.2.2/modules/hal/telink)"
osource "/home/panosalex/zephyr_v4.2.2/modules/hal/telink/Kconfig"
config ZEPHYR_HAL_TELINK_MODULE
	bool
	default y
endmenu
config ZEPHYR_TI_MODULE
	bool
	default y
menu "hal_wch (/home/panosalex/zephyr_v4.2.2/modules/hal/wch)"
osource "$(ZEPHYR_HAL_WCH_KCONFIG)"
config ZEPHYR_HAL_WCH_MODULE
	bool
	default y
endmenu
config ZEPHYR_HAL_WURTHELEKTRONIK_MODULE
	bool
	default y
config ZEPHYR_XTENSA_MODULE
	bool
	default y
menu "hostap (/home/panosalex/zephyr_v4.2.2/modules/lib/hostap)"
osource "$(ZEPHYR_HOSTAP_KCONFIG)"
config ZEPHYR_HOSTAP_MODULE
	bool
	default y
endmenu
menu "liblc3 (/home/panosalex/zephyr_v4.2.2/modules/lib/liblc3)"
osource "$(ZEPHYR_LIBLC3_KCONFIG)"
config ZEPHYR_LIBLC3_MODULE
	bool
	default y
endmenu
config ZEPHYR_LIBMCTP_MODULE
	bool
	default y
config ZEPHYR_LIBMETAL_MODULE
	bool
	default y
menu "littlefs (/home/panosalex/zephyr_v4.2.2/modules/fs/littlefs)"
osource "$(ZEPHYR_LITTLEFS_KCONFIG)"
config ZEPHYR_LITTLEFS_MODULE
	bool
	default y
endmenu
menu "loramac-node (/home/panosalex/zephyr_v4.2.2/modules/lib/loramac-node)"
osource "$(ZEPHYR_LORAMAC_NODE_KCONFIG)"
config ZEPHYR_LORAMAC_NODE_MODULE
	bool
	default y
endmenu
menu "lvgl (/home/panosalex/zephyr_v4.2.2/modules/lib/gui/lvgl)"
osource "/home/panosalex/zephyr_v4.2.2/modules/lib/gui/lvgl/zephyr/Kconfig"
config ZEPHYR_LVGL_MODULE
	bool
	default y
endmenu
menu "mbedtls (/home/panosalex/zephyr_v4.2.2/modules/crypto/mbedtls)"
osource "$(ZEPHYR_MBEDTLS_KCONFIG)"
config ZEPHYR_MBEDTLS_MODULE
	bool
	default y
endmenu
config ZEPHYR_MCUBOOT_MODULE
	bool
	default y
config ZEPHYR_MIPI_SYS_T_MODULE
	bool
	default y
menu "nrf_wifi (/home/panosalex/zephyr_v4.2.2/modules/lib/nrf_wifi)"
osource "$(ZEPHYR_NRF_WIFI_KCONFIG)"
config ZEPHYR_NRF_WIFI_MODULE
	bool
	default y

config ZEPHYR_NRF_WIFI_MODULE_BLOBS
	bool
endmenu
config ZEPHYR_OPEN_AMP_MODULE
	bool
	default y
menu "openthread (/home/panosalex/zephyr_v4.2.2/modules/lib/openthread)"
osource "$(ZEPHYR_OPENTHREAD_KCONFIG)"
config ZEPHYR_OPENTHREAD_MODULE
	bool
	default y
endmenu
menu "percepio (/home/panosalex/zephyr_v4.2.2/modules/debug/percepio)"
osource "/home/panosalex/zephyr_v4.2.2/modules/debug/percepio/zephyr/Kconfig"
config ZEPHYR_PERCEPIO_MODULE
	bool
	default y
endmenu
menu "picolibc (/home/panosalex/zephyr_v4.2.2/modules/lib/picolibc)"
osource "/home/panosalex/zephyr_v4.2.2/modules/lib/picolibc/zephyr/Kconfig"
config ZEPHYR_PICOLIBC_MODULE
	bool
	default y
endmenu
menu "segger (/home/panosalex/zephyr_v4.2.2/modules/debug/segger)"
osource "$(ZEPHYR_SEGGER_KCONFIG)"
config ZEPHYR_SEGGER_MODULE
	bool
	default y
endmenu
config ZEPHYR_TINYCRYPT_MODULE
	bool
	default y
menu "trusted-firmware-a (/home/panosalex/zephyr_v4.2.2/modules/tee/tf-a/trusted-firmware-a)"
osource "$(ZEPHYR_TRUSTED_FIRMWARE_A_KCONFIG)"
config ZEPHYR_TRUSTED_FIRMWARE_A_MODULE
	bool
	default y
endmenu
menu "trusted-firmware-m (/home/panosalex/zephyr_v4.2.2/modules/tee/tf-m/trusted-firmware-m)"
osource "$(ZEPHYR_TRUSTED_FIRMWARE_M_KCONFIG)"
config ZEPHYR_TRUSTED_FIRMWARE_M_MODULE
	bool
	default y
endmenu
menu "uoscore-uedhoc (/home/panosalex/zephyr_v4.2.2/modules/lib/uoscore-uedhoc)"
osource "$(ZEPHYR_UOSCORE_UEDHOC_KCONFIG)"
config ZEPHYR_UOSCORE_UEDHOC_MODULE
	bool
	default y
endmenu
menu "zcbor (/home/panosalex/zephyr_v4.2.2/modules/lib/zcbor)"
osource "$(ZEPHYR_ZCBOR_KCONFIG)"
config ZEPHYR_ZCBOR_MODULE
	bool
	default y
endmenu
config ZEPHYR_NRF_HW_MODELS_MODULE
	bool
	default y
```

## samples/zephyr_OT_pq_edhoc_KEM/initiator/build_falcon_board/Kconfig/arch/Kconfig
```kconfig
# Load Zephyr Arch Kconfig descriptions.
osource "/home/panosalex/zephyr_v4.2.2/zephyr/arch/rx/Kconfig"
osource "/home/panosalex/zephyr_v4.2.2/zephyr/arch/x86/Kconfig"
osource "/home/panosalex/zephyr_v4.2.2/zephyr/arch/xtensa/Kconfig"
osource "/home/panosalex/zephyr_v4.2.2/zephyr/arch/sparc/Kconfig"
osource "/home/panosalex/zephyr_v4.2.2/zephyr/arch/riscv/Kconfig"
osource "/home/panosalex/zephyr_v4.2.2/zephyr/arch/posix/Kconfig"
osource "/home/panosalex/zephyr_v4.2.2/zephyr/arch/mips/Kconfig"
osource "/home/panosalex/zephyr_v4.2.2/zephyr/arch/arm64/Kconfig"
osource "/home/panosalex/zephyr_v4.2.2/zephyr/arch/arm/Kconfig"
osource "/home/panosalex/zephyr_v4.2.2/zephyr/arch/arc/Kconfig"
```

## samples/zephyr_OT_pq_edhoc_KEM/initiator/build_falcon_board/Kconfig/boards/Kconfig
```kconfig
# Load Zephyr board Kconfig descriptions.
osource "/home/panosalex/zephyr_v4.2.2/zephyr/boards/nordic/nrf52840dk/Kconfig"
```

## samples/zephyr_OT_pq_edhoc_KEM/initiator/build_falcon_board/Kconfig/boards/Kconfig.defconfig
```kconfig
# Load Zephyr board defconfig descriptions.
osource "/home/panosalex/zephyr_v4.2.2/zephyr/boards/nordic/nrf52840dk/Kconfig.defconfig"
```

## samples/zephyr_OT_pq_edhoc_KEM/initiator/build_falcon_board/Kconfig/boards/Kconfig.sysbuild
```kconfig
# Load Sysbuild board Kconfig descriptions.
osource "/home/panosalex/zephyr_v4.2.2/zephyr/boards/nordic/nrf52840dk/Kconfig.sysbuild"
```
