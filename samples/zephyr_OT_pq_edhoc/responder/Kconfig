## samples/zephyr_OT_pq_edhoc_KEM/initiator/build_falcon_board/Kconfig/soc/Kconfig
```kconfig
# Load Zephyr SoC Kconfig descriptions.
osource "/home/panosalex/zephyr_v4.2.2/zephyr/soc/xlnx/zynqmp/Kconfig"
osource "/home/panosalex/zephyr_v4.2.2/zephyr/soc/xlnx/zynq7000/Kconfig"
osource "/home/panosalex/zephyr_v4.2.2/zephyr/soc/xlnx/versalnet/Kconfig"
osource "/home/panosalex/zephyr_v4.2.2/zephyr/soc/xlnx/versal2/Kconfig"
osource "/home/panosalex/zephyr_v4.2.2/zephyr/soc/xen/Kconfig"
osource "/home/panosalex/zephyr_v4.2.2/zephyr/soc/wch/ch32v/Kconfig"
osource "/home/panosalex/zephyr_v4.2.2/zephyr/soc/ti/simplelink/Kconfig"
osource "/home/panosalex/zephyr_v4.2.2/zephyr/soc/ti/mspm0/Kconfig"
osource "/home/panosalex/zephyr_v4.2.2/zephyr/soc/ti/lm3s6965/Kconfig"
osource "/home/panosalex/zephyr_v4.2.2/zephyr/soc/ti/k3/Kconfig"
osource "/home/panosalex/zephyr_v4.2.2/zephyr/soc/telink/tlsr/Kconfig"
osource "/home/panosalex/zephyr_v4.2.2/zephyr/soc/starfive/jh71xx/Kconfig"
osource "/home/panosalex/zephyr_v4.2.2/zephyr/soc/st/stm32/Kconfig"
osource "/home/panosalex/zephyr_v4.2.2/zephyr/soc/snps/qemu_arc/Kconfig"
osource "/home/panosalex/zephyr_v4.2.2/zephyr/soc/snps/nsim/arc_v/Kconfig"
osource "/home/panosalex/zephyr_v4.2.2/zephyr/soc/snps/nsim/arc_classic/Kconfig"
osource "/home/panosalex/zephyr_v4.2.2/zephyr/soc/snps/hsdk4xd/Kconfig"
osource "/home/panosalex/zephyr_v4.2.2/zephyr/soc/snps/hsdk/Kconfig"
osource "/home/panosalex/zephyr_v4.2.2/zephyr/soc/snps/emsk/Kconfig"
osource "/home/panosalex/zephyr_v4.2.2/zephyr/soc/snps/emsdp/Kconfig"
osource "/home/panosalex/zephyr_v4.2.2/zephyr/soc/snps/arc_iot/Kconfig"
osource "/home/panosalex/zephyr_v4.2.2/zephyr/soc/silabs/Kconfig"
osource "/home/panosalex/zephyr_v4.2.2/zephyr/soc/sifive/sifive_freedom/Kconfig"
osource "/home/panosalex/zephyr_v4.2.2/zephyr/soc/sensry/Kconfig"
osource "/home/panosalex/zephyr_v4.2.2/zephyr/soc/rockchip/Kconfig"
osource "/home/panosalex/zephyr_v4.2.2/zephyr/soc/renode/riscv_virtual/Kconfig"
osource "/home/panosalex/zephyr_v4.2.2/zephyr/soc/renode/cortex_r8_virtual/Kconfig"
osource "/home/panosalex/zephyr_v4.2.2/zephyr/soc/renesas/smartbond/Kconfig"
osource "/home/panosalex/zephyr_v4.2.2/zephyr/soc/renesas/rz/Kconfig"
osource "/home/panosalex/zephyr_v4.2.2/zephyr/soc/renesas/rx/Kconfig"
osource "/home/panosalex/zephyr_v4.2.2/zephyr/soc/renesas/rcar/Kconfig"
osource "/home/panosalex/zephyr_v4.2.2/zephyr/soc/renesas/ra/Kconfig"
osource "/home/panosalex/zephyr_v4.2.2/zephyr/soc/realtek/ec/Kconfig"
osource "/home/panosalex/zephyr_v4.2.2/zephyr/soc/raspberrypi/rpi_pico/Kconfig"
osource "/home/panosalex/zephyr_v4.2.2/zephyr/soc/quicklogic/eos_s3/Kconfig"
osource "/home/panosalex/zephyr_v4.2.2/zephyr/soc/qemu/virt_riscv/Kconfig"
osource "/home/panosalex/zephyr_v4.2.2/zephyr/soc/qemu/malta/Kconfig"
osource "/home/panosalex/zephyr_v4.2.2/zephyr/soc/openisa/rv32m1/Kconfig"
osource "/home/panosalex/zephyr_v4.2.2/zephyr/soc/openhwgroup/cva6/Kconfig"
osource "/home/panosalex/zephyr_v4.2.2/zephyr/soc/oct/osd32mp15x/Kconfig"
osource "/home/panosalex/zephyr_v4.2.2/zephyr/soc/nxp/s32/Kconfig"
osource "/home/panosalex/zephyr_v4.2.2/zephyr/soc/nxp/rw/Kconfig"
osource "/home/panosalex/zephyr_v4.2.2/zephyr/soc/nxp/mcx/Kconfig"
osource "/home/panosalex/zephyr_v4.2.2/zephyr/soc/nxp/lpc/Kconfig"
osource "/home/panosalex/zephyr_v4.2.2/zephyr/soc/nxp/layerscape/Kconfig"
osource "/home/panosalex/zephyr_v4.2.2/zephyr/soc/nxp/kinetis/Kconfig"
osource "/home/panosalex/zephyr_v4.2.2/zephyr/soc/nxp/imxrt/Kconfig"
osource "/home/panosalex/zephyr_v4.2.2/zephyr/soc/nxp/imx/Kconfig"
osource "/home/panosalex/zephyr_v4.2.2/zephyr/soc/nuvoton/numicro/Kconfig"
osource "/home/panosalex/zephyr_v4.2.2/zephyr/soc/nuvoton/numaker/Kconfig"
osource "/home/panosalex/zephyr_v4.2.2/zephyr/soc/nuvoton/npcx/Kconfig"
osource "/home/panosalex/zephyr_v4.2.2/zephyr/soc/nuvoton/npcm/Kconfig"
osource "/home/panosalex/zephyr_v4.2.2/zephyr/soc/nordic/Kconfig"
osource "/home/panosalex/zephyr_v4.2.2/zephyr/soc/neorv32/Kconfig"
osource "/home/panosalex/zephyr_v4.2.2/zephyr/soc/native/inf_clock/Kconfig"
osource "/home/panosalex/zephyr_v4.2.2/zephyr/soc/microchip/sam/Kconfig"
osource "/home/panosalex/zephyr_v4.2.2/zephyr/soc/microchip/miv/Kconfig"
osource "/home/panosalex/zephyr_v4.2.2/zephyr/soc/microchip/mec/Kconfig"
osource "/home/panosalex/zephyr_v4.2.2/zephyr/soc/mediatek/mt8xxx/Kconfig"
osource "/home/panosalex/zephyr_v4.2.2/zephyr/soc/lowrisc/opentitan/Kconfig"
osource "/home/panosalex/zephyr_v4.2.2/zephyr/soc/litex/litex_vexriscv/Kconfig"
osource "/home/panosalex/zephyr_v4.2.2/zephyr/soc/ite/ec/Kconfig"
osource "/home/panosalex/zephyr_v4.2.2/zephyr/soc/intel/raptor_lake/Kconfig"
osource "/home/panosalex/zephyr_v4.2.2/zephyr/soc/intel/lakemont/Kconfig"
osource "/home/panosalex/zephyr_v4.2.2/zephyr/soc/intel/intel_socfpga_std/Kconfig"
osource "/home/panosalex/zephyr_v4.2.2/zephyr/soc/intel/intel_socfpga/Kconfig"
osource "/home/panosalex/zephyr_v4.2.2/zephyr/soc/intel/intel_niosv/Kconfig"
osource "/home/panosalex/zephyr_v4.2.2/zephyr/soc/intel/intel_ish/Kconfig"
osource "/home/panosalex/zephyr_v4.2.2/zephyr/soc/intel/intel_adsp/Kconfig"
osource "/home/panosalex/zephyr_v4.2.2/zephyr/soc/intel/elkhart_lake/Kconfig"
osource "/home/panosalex/zephyr_v4.2.2/zephyr/soc/intel/atom/Kconfig"
osource "/home/panosalex/zephyr_v4.2.2/zephyr/soc/intel/apollo_lake/Kconfig"
osource "/home/panosalex/zephyr_v4.2.2/zephyr/soc/intel/alder_lake/Kconfig"
osource "/home/panosalex/zephyr_v4.2.2/zephyr/soc/infineon/cat3/Kconfig"
osource "/home/panosalex/zephyr_v4.2.2/zephyr/soc/infineon/cat1c/Kconfig"
osource "/home/panosalex/zephyr_v4.2.2/zephyr/soc/infineon/cat1b/Kconfig"
osource "/home/panosalex/zephyr_v4.2.2/zephyr/soc/infineon/cat1a/Kconfig"
osource "/home/panosalex/zephyr_v4.2.2/zephyr/soc/gd/gd32/Kconfig"
osource "/home/panosalex/zephyr_v4.2.2/zephyr/soc/gaisler/leon3/Kconfig"
osource "/home/panosalex/zephyr_v4.2.2/zephyr/soc/gaisler/gr716a/Kconfig"
osource "/home/panosalex/zephyr_v4.2.2/zephyr/soc/espressif/Kconfig"
osource "/home/panosalex/zephyr_v4.2.2/zephyr/soc/ene/kb1200/Kconfig"
osource "/home/panosalex/zephyr_v4.2.2/zephyr/soc/ene/kb106x/Kconfig"
osource "/home/panosalex/zephyr_v4.2.2/zephyr/soc/efinix/sapphire/Kconfig"
osource "/home/panosalex/zephyr_v4.2.2/zephyr/soc/cdns/xtensa_sample_controller/Kconfig"
osource "/home/panosalex/zephyr_v4.2.2/zephyr/soc/cdns/sample_controller32/Kconfig"
osource "/home/panosalex/zephyr_v4.2.2/zephyr/soc/cdns/dc233c/Kconfig"
osource "/home/panosalex/zephyr_v4.2.2/zephyr/soc/brcm/bcmvk/Kconfig"
osource "/home/panosalex/zephyr_v4.2.2/zephyr/soc/brcm/bcm2712/Kconfig"
osource "/home/panosalex/zephyr_v4.2.2/zephyr/soc/brcm/bcm2711/Kconfig"
osource "/home/panosalex/zephyr_v4.2.2/zephyr/soc/bflb/Kconfig"
osource "/home/panosalex/zephyr_v4.2.2/zephyr/soc/atmel/sam0/Kconfig"
osource "/home/panosalex/zephyr_v4.2.2/zephyr/soc/atmel/sam/Kconfig"
osource "/home/panosalex/zephyr_v4.2.2/zephyr/soc/aspeed/Kconfig"
osource "/home/panosalex/zephyr_v4.2.2/zephyr/soc/arm/Kconfig"
osource "/home/panosalex/zephyr_v4.2.2/zephyr/soc/arm/beetle/Kconfig"
osource "/home/panosalex/zephyr_v4.2.2/zephyr/soc/antmicro/myra/Kconfig"
osource "/home/panosalex/zephyr_v4.2.2/zephyr/soc/andestech/Kconfig"
osource "/home/panosalex/zephyr_v4.2.2/zephyr/soc/amd/acp_6_0/Kconfig"
osource "/home/panosalex/zephyr_v4.2.2/zephyr/soc/ambiq/Kconfig"
osource "/home/panosalex/zephyr_v4.2.2/zephyr/soc/aesc/Kconfig"
osource "/home/panosalex/zephyr_v4.2.2/zephyr/soc/adi/max32/Kconfig"
```
