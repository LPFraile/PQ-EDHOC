## CMakeLists.txt
```
# SPDX-License-Identifier: Apache-2.0

cmake_minimum_required(VERSION 3.13.1)
find_package(Zephyr REQUIRED HINTS $ENV{ZEPHYR_BASE})
project(initiator)

FILE(GLOB app_sources 
	src/*.c
	../../common/sock_ipv6.c
	../../../externals/zcbor/src/*.c
	#../../../externals/compact25519/src/c25519/*.c
	#../../../externals/compact25519/src/*.c
	../../../externals/mbedtls/library/*.c
	../../../externals/pqm4/crypto_kem/kyber512/m4fstack/*.c
	../../../externals/pqm4/crypto_kem/kyber512/m4fstack/*.i
	../../../externals/pqm4/crypto_kem/kyber512/m4fstack/*.S
	#../../../externals/pqm4/crypto_sign/dilithium2/m4fstack/*.c
	#../../../externals/pqm4/crypto_sign/dilithium2/m4fstack/*.i
	#../../../externals/pqm4/crypto_sign/dilithium2/m4fstack/*.S
	#../../../externals/pqm4/crypto_sign/dilithium2/m4fstack/*.s
	../../../externals/pqm4/crypto_sign/falcon-512/m4-ct/*.c
	../../../externals/pqm4/crypto_sign/falcon-512/m4-ct/*.i
	../../../externals/pqm4/crypto_sign/falcon-512/m4-ct/*.S
	../../../externals/pqm4/crypto_sign/falcon-512/m4-ct/*.s
	../../../externals/pqm4/common/randombytes.c
	../../../externals/pqm4/common/keccakf1600.S
	../../../externals/pqm4/common/crypto_hashblocks_sha512*.*
	../../../externals/pqm4/common/aes.*
	../../../externals/pqm4/mupq/common/fips202.c)
target_sources(app PRIVATE ${app_sources})
target_sources(app PRIVATE ${ZEPHYR_BASE}/subsys/net/lib/coap/coap_client.c)
target_sources(app PRIVATE ${ZEPHYR_BASE}/subsys/net/lib/coap/coap.c)
target_include_directories(app PRIVATE $ENV{ZEPHYR_BASE}/include)
target_include_directories(app PRIVATE 
	$ENV{ZEPHYR_BASE}/subsys/net/ip
	.
	../../common
	../../../inc
	../../../test_vectors
	../../../externals/zcbor/include 
	../../../externals/mbedtls/library 
	../../../externals/mbedtls/include 
	../../../externals/mbedtls/include/mbedtls 
	../../../externals/mbedtls/include/psa
	../../../externals/pqm4/crypto_kem/kyber512/m4fstack
	../../../externals/pqm4/common/aes.h
	../../../externals/pqm4/crypto_sign/falcon-512/m4-ct
	#../../../externals/pqm4/crypto_sign/dilithium2/m4fstack
	../../../externals/pqm4/mupq/common
	../../../externals/pqm4/libopencm3/include)

	#target_include_directories(app PRIVATE ${ZEPHYR_BASE}/include/)

add_definitions(
	-DMBEDTLS_CONFIG_FILE="mbedtls_config_uoscore_uedhoc.h"
	-DDEBUG_PRINT
	-DZCBOR_CANONICAL
)
add_compile_definitions(CONFIG_COAP_CLIENT=y)
add_compile_definitions(CONFIG_COAP_CLIENT_BLOCK_SIZE=512)
add_compile_definitions(CONFIG_COAP_CLIENT_MESSAGE_SIZE=512)
add_compile_definitions(CONFIG_COAP_CLIENT_MESSAGE_HEADER_SIZE=48)
add_compile_definitions(CONFIG_COAP_CLIENT_STACK_SIZE=2024)
add_compile_definitions(CONFIG_COAP_CLIENT_THREAD_PRIORITY=4)
add_compile_definitions(CONFIG_COAP_LOG_LEVEL=1)
add_compile_definitions(CONFIG_NET_SOCKETS_POSIX_NAMES=y)
add_compile_definitions(CONFIG_COAP_INIT_ACK_TIMEOUT_MS=20000)



# The external static library that we are linking with does not know
# how to build for this platform so we export all the flags used in
# this zephyr build to the external build system.
zephyr_get_include_directories_for_lang_as_string(       C includes)
zephyr_get_system_include_directories_for_lang_as_string(C system_includes)
zephyr_get_compile_definitions_for_lang_as_string(       C definitions)
zephyr_get_compile_options_for_lang_as_string(           C options)

set(external_project_cflags
  "${includes} ${definitions} ${options} ${system_includes}"
  )

include(ExternalProject)

# Add an external project to be able download and build the third
# party library. In this case downloading is not necessary as it has
# been committed to the repository.
set(src_dir   ${CMAKE_CURRENT_SOURCE_DIR}/../../..)
set(build_dir ${CMAKE_CURRENT_BINARY_DIR}/uoscore_uedhoc)

set(LIB_TEST_LIB_DIR     ${CMAKE_CURRENT_SOURCE_DIR}/../build)
set(INCLUDE_DIR ${CMAKE_CURRENT_SOURCE_DIR}/..)


if(CMAKE_GENERATOR STREQUAL "Unix Makefiles")
# https://www.gnu.org/software/make/manual/html_node/MAKE-Variable.html
set(submake "$(MAKE)")
else() # Obviously no MAKEFLAGS. Let's hope a "make" can be found somewhere.
set(submake "make")
endif()

message("build_dir: ${build_dir}")
message("CMAKE_CURRENT_SOURCE_DIR: ${CMAKE_CURRENT_SOURCE_DIR}")
message("CMAKE_CURRENT_BINARY_DIR: ${CMAKE_CURRENT_BINARY_DIR}")
message("LIB_TEST_LIB_DIR: ${LIB_TEST_LIB_DIR}")
message("INCLUDE_DIR: ${INCLUDE_DIR}")



ExternalProject_Add(
  oscore_edhoc_project                 # Name for custom target
  PREFIX ${build_dir} # Root dir for entire project
  SOURCE_DIR ${src_dir}
  BINARY_DIR ${src_dir} # This particular build system is invoked from the root
  CONFIGURE_COMMAND ""    # Skip configuring the project, e.g. with autoconf
  BUILD_COMMAND
  ${submake}
  PREFIX=${build_dir}
  CC=${CMAKE_C_COMPILER}
  AR=${CMAKE_AR}
  CFLAGS=${external_project_cflags}
  INSTALL_COMMAND ""      # This particular build system has no install command
  BUILD_BYPRODUCTS ${build_dir}/libuoscore-uedhoc.a
  )

# Create a wrapper CMake library that our app can link with
add_library(test STATIC IMPORTED GLOBAL)
add_dependencies(
	test
	oscore_edhoc_project)

set_target_properties(test PROPERTIES IMPORTED_LOCATION 
	${build_dir}/libuoscore-uedhoc.a)

target_include_directories(test INTERFACE
	${INCLUDE_DIR})

target_link_libraries(app PRIVATE test)
```

## prj.conf
```kconfig
# Generic networking options
CONFIG_NETWORKING=y
CONFIG_NET_UDP=y
CONFIG_NEWLIB_LIBC=y

# Socket
CONFIG_NET_SOCKETS=y
CONFIG_NET_SOCKETS_POSIX_NAMES=y
CONFIG_NET_SOCKETS_POLL_MAX=4

# CoAP
#CONFIG_COAP=y
#CONFIG_COAP_WELL_KNOWN_BLOCK_WISE=n
#CONFIG_COAP_CLIENT_MESSAGE_SIZE=128
#CONFIG_COAP_CLIENT=y
#CONFIG_COAP_CLIENT_BLOCK_SIZE=256
#CONFIG_COAP_CLIENT_MESSAGE_SIZE=256
#CONFIG_COAP_CLIENT_MESSAGE_HEADER_SIZE=48
#CONFIG_COAP_CLIENT_STACK_SIZE=1024
#CONFIG_COAP_CLIENT_THREAD_PRIORITY=10
#CONFIG_COAP_LOG_LEVEL=4
#CONFIG_NET_SOCKETS_POSIX_NAMES=y
#CONFIG_COAP_INIT_ACK_TIMEOUT_MS=2000

# Kernel options
CONFIG_ENTROPY_GENERATOR=y
CONFIG_TEST_RANDOM_GENERATOR=y

# Logging
#CONFIG_PRINTK=y
#CONFIG_NET_LOG=y

# Network Shell
#CONFIG_NET_SHELL=y

# Configuration
CONFIG_NET_CONFIG_SETTINGS=y
CONFIG_NET_CONFIG_BT_NODE=y
CONFIG_NET_MAX_CONTEXTS=6
CONFIG_NET_PKT_RX_COUNT=10
CONFIG_NET_PKT_TX_COUNT=10
CONFIG_NET_BUF_RX_COUNT=20
CONFIG_NET_BUF_TX_COUNT=20
CONFIG_NET_L2_BT=y


# IPv6 Support
CONFIG_NET_IPV4=n
CONFIG_NET_IPV6=y
# CONFIG_NET_CONFIG_NEED_IPV6=y
CONFIG_NET_CONFIG_MY_IPV6_ADDR="2001:db8::1"
CONFIG_NET_CONFIG_PEER_IPV6_ADDR="2001:db8::2"
CONFIG_NET_IF_UNICAST_IPV6_ADDR_COUNT=3
CONFIG_NET_IF_MCAST_IPV6_ADDR_COUNT=4
CONFIG_NET_MAX_CONTEXTS=6



# RAM configuration
CONFIG_INIT_STACKS=y
#CONFIG_MAIN_STACK_SIZE=20000
CONFIG_HEAP_MEM_POOL_SIZE=32192

CONFIG_MAIN_STACK_SIZE=14096
CONFIG_IDLE_STACK_SIZE=1024

CONFIG_SYSTEM_WORKQUEUE_STACK_SIZE=1024
# Configure Bluetooth LE
CONFIG_BT=y
#CONFIG_BT_DEBUG_LOG=y
CONFIG_BT_SMP=y
CONFIG_BT_PERIPHERAL=y
CONFIG_BT_CENTRAL=y
CONFIG_BT_L2CAP_DYNAMIC_CHANNEL=y
CONFIG_BT_DEVICE_NAME="EdhocInitiator"
#CONFIG_BT_L2CAP_ECRED=y

#testing for credits


# Allow for large Bluetooth data packets.
#CONFIG_BT_L2CAP_TX_MTU=498
#CONFIG_BT_BUF_ACL_RX_SIZE=502
#CONFIG_BT_BUF_ACL_TX_SIZE=502
#CONFIG_BT_CTLR_DATA_LENGTH_MAX=251
# Compiler optimization
# CONFIG_COMPILER_OPT="-O3"
# CONFIG_COMPILER_OPT="-Os"

#CONFIG_GPIO=y

# Config Crypto
# CONFIG_TINYCBOR=y
# CONFIG_TINYCRYPT=y
# CONFIG_TINYCRYPT_AES=y
# CONFIG_TINYCRYPT_AES_CCM=y
# CONFIG_TINYCRYPT_SHA256=y
# CONFIG_TINYCRYPT_SHA256_HMAC=y
# Enable floating-point operations
CONFIG_FP_HARDABI=y
CONFIG_FPU=y

# Compiler optimizations will be set to -Og independently of other options.
CONFIG_DEBUG=y
# CONFIG_DEBUG_INFO=y
# CONFIG_DEBUG_OPTIMIZATIONS=y
# CONFIG_SYS_PM_DEBUG=y
CONFIG_BT_RX_STACK_SIZE=2024
CONFIG_BT_HCI_TX_STACK_SIZE=2024

#CONFIG_BT_DEBUG_L2CAP=y
#CONFIG_NET_L2_BT_LOG_LEVEL_DBG=y

# Logging Configuration
CONFIG_LOG=y
CONFIG_LOG_DEFAULT_LEVEL=1
CONFIG_LOG_PROCESS_THREAD=y
CONFIG_LOG_PROCESS_THREAD_STACK_SIZE=1024
CONFIG_LOG_BUFFER_SIZE=1024
# Network Configuration
CONFIG_NET_TX_STACK_SIZE=2048
CONFIG_NET_RX_STACK_SIZE=2048
CONFIG_BT_CTLR_RX_PRIO_STACK_SIZE=1024
#CONFIG_BT_BUF_ACL_RX_COUNT=6

# Debug and Fault Analysis
#CONFIG_DEBUG=y
#CONFIG_PRINTK=y
#CONFIG_THREAD_STACK_INFO=y
#CONFIG_STACK_SENTINEL=y
#CONFIG_THREAD_MONITOR=y
#CONFIG_MPU_STACK_GUARD=y
#CONFIG_STACK_CANARIES=y
#CONFIG_INIT_STACKS=y
#CONFIG_THREAD_ANALYZER=y
#CONFIG_THREAD_NAME=y
#CONFIG_THREAD_ANALYZER_AUTO=y
```

## src/main.c
```c
/*
   Copyright (c) 2021 Fraunhofer AISEC. See the COPYRIGHT
   file at the top-level directory of this distribution.

   Licensed under the Apache License, Version 2.0 <LICENSE-APACHE or
   http://www.apache.org/licenses/LICENSE-2.0> or the MIT license
   <LICENSE-MIT or http://opensource.org/licenses/MIT>, at your
   option. This file may not be copied, modified, or distributed
   except according to those terms.
*/

#include <stdio.h>
//#include <zephyr/net/coap_client.h>

//#include "edhoc.h"
//#include "sock.h"
#include "edhoc_test_vectors_p256_v16.h"
//#include "common/crypto_wrapper.h"
//#include <api.h>

#define URI_PATH 11
#define PQ_PROPOSAL_1




void edhoc_initiator_init(void)
{
	PRINT_MSG("Init EDHOC\n");
	int r = internal_main();
	if (r != 0) {
		printf("error during initiator run. Error code: %d\n", r);
	}
}


int internal_main(void)
{
	/*if (k_sem_take(&my_sem_init, K_MSEC(50)) != 0) {
	}
	else{
		PRINT_MSG("ok\n");
	}	*/


	/*BYTE_ARRAY_NEW(prk_exporter, 32, 32);
	BYTE_ARRAY_NEW(oscore_master_secret, 16, 16);
	BYTE_ARRAY_NEW(oscore_master_salt, 8, 8);
	BYTE_ARRAY_NEW(PRK_out, 32, 32);
	BYTE_ARRAY_NEW(err_msg, 0, 0);*/
	uint8_t prk_ex[32];
	uint8_t oscore_secret[16];
	uint8_t oscore_salt[8];
	uint8_t PRK[32];	
	uint8_t err[0];
	struct byte_array prk_exporter;
	prk_exporter.ptr = prk_ex;
	prk_exporter.len = 32;
	struct byte_array err_msg;
	err_msg.ptr = err;
	err_msg.len = 1;
	struct byte_array PRK_out;
	PRK_out.ptr = PRK;
	PRK_out.len = 32;
	struct byte_array oscore_master_secret;
    oscore_master_secret.ptr = oscore_secret;
	oscore_master_secret.len = 16;

	struct byte_array oscore_master_salt;
    oscore_master_salt.ptr = oscore_salt;
	oscore_master_salt.len = 8;

	/* test vector inputs */
	struct other_party_cred cred_r;
	struct edhoc_initiator_context c_i;

	const uint8_t TEST_VEC_NUM = 8;
	uint8_t vec_num_i = TEST_VEC_NUM - 1;

	c_i.c_i.len = test_vectors[vec_num_i].c_i_len;
	c_i.c_i.ptr = (uint8_t *)test_vectors[vec_num_i].c_i;
	c_i.method = (enum method_type) * test_vectors[vec_num_i].method;
	c_i.suites_i.len = test_vectors[vec_num_i].SUITES_I_len;
	c_i.suites_i.ptr = (uint8_t *)test_vectors[vec_num_i].SUITES_I;
	c_i.ead_1.len = test_vectors[vec_num_i].ead_1_len;
	c_i.ead_1.ptr = (uint8_t *)test_vectors[vec_num_i].ead_1;
	c_i.ead_3.len = test_vectors[vec_num_i].ead_3_len;
	c_i.ead_3.ptr = (uint8_t *)test_vectors[vec_num_i].ead_3;
	c_i.id_cred_i.len = test_vectors[vec_num_i].id_cred_i_len;
	c_i.id_cred_i.ptr = (uint8_t *)test_vectors[vec_num_i].id_cred_i;
	c_i.cred_i.len = test_vectors[vec_num_i].cred_i_len;
	c_i.cred_i.ptr = (uint8_t *)test_vectors[vec_num_i].cred_i;
	c_i.g_x.len = test_vectors[vec_num_i].g_x_raw_len;
	c_i.g_x.ptr = (uint8_t *)test_vectors[vec_num_i].g_x_raw;
	c_i.x.len = test_vectors[vec_num_i].x_raw_len;
	c_i.x.ptr = (uint8_t *)test_vectors[vec_num_i].x_raw;
	c_i.g_i.len = test_vectors[vec_num_i].g_i_raw_len;
	c_i.g_i.ptr = (uint8_t *)test_vectors[vec_num_i].g_i_raw;
	c_i.i.len = test_vectors[vec_num_i].i_raw_len;
	c_i.i.ptr = (uint8_t *)test_vectors[vec_num_i].i_raw;
	c_i.sk_i.len = test_vectors[vec_num_i].sk_i_raw_len;
	c_i.sk_i.ptr = (uint8_t *)test_vectors[vec_num_i].sk_i_raw;
	c_i.pk_i.len = test_vectors[vec_num_i].pk_i_raw_len;
	c_i.pk_i.ptr = (uint8_t *)test_vectors[vec_num_i].pk_i_raw;

	cred_r.id_cred.len = test_vectors[vec_num_i].id_cred_r_len;
	cred_r.id_cred.ptr = (uint8_t *)test_vectors[vec_num_i].id_cred_r;
	cred_r.cred.len = test_vectors[vec_num_i].cred_r_len;
	cred_r.cred.ptr = (uint8_t *)test_vectors[vec_num_i].cred_r;
	cred_r.g.len = test_vectors[vec_num_i].g_r_raw_len;
	cred_r.g.ptr = (uint8_t *)test_vectors[vec_num_i].g_r_raw;
	cred_r.pk.len = test_vectors[vec_num_i].pk_r_raw_len;
	cred_r.pk.ptr = (uint8_t *)test_vectors[vec_num_i].pk_r_raw;
	cred_r.ca.len = test_vectors[vec_num_i].ca_r_len;
	cred_r.ca.ptr = (uint8_t *)test_vectors[vec_num_i].ca_r;
	cred_r.ca_pk.len = test_vectors[vec_num_i].ca_r_pk_len;
	cred_r.ca_pk.ptr = (uint8_t *)test_vectors[vec_num_i].ca_r_pk;

    #ifdef PQ_PROPOSAL_1
    /*Ephemeral Key generation for KEMs*/

	struct suite suit_in;
	get_suite((enum suite_label)c_i.suites_i.ptr[c_i.suites_i.len - 1],
		      &suit_in);
	PRINTF("INITIATOR SUIT kem: %d, signature %d\n",suit_in.edhoc_ecdh,suit_in.edhoc_sign)
	
	#endif

   
	struct cred_array cred_r_array = { .len = 1, .ptr = &cred_r };
    
	for (size_t i = 0; i < 100; i++)
	{
			size_t sig_len = 690;
			uint8_t sig[sig_len];
			int i = 0;
			for (i = 0; i < sig_len; ++i) {
				sig[i] = 0;
			}
			uint8_t message[32] = "heeeeeeeelloooooooooooooooooo!";
			//PRINT_ARRAY("sk:",c_i.sk_i.ptr,c_i.sk_i.len);	
			//Testing for sign errors
			int ret = crypto_sign_signature(sig, &sig_len, message, 32, c_i.sk_i.ptr);
			PRINTF("crypto sign signature RET: %d\n",ret);
			PRINTF("sign size: %d\n",sig_len);
			//PRINT_ARRAY("SIGN:",sig,sig_len);

			ret = crypto_sign_verify(sig, sig_len, message, 32, c_i.pk_i.ptr);
			if(ret == 0){
				PRINT_MSG("Verify success!\n");
			}
			else{
				PRINT_MSG("verify fail!\n");
			}
	}
	
	/*#define MSG_LEN 32
	size_t sm_len = 690 + MSG_LEN;
	uint8_t sm[sm_len];
	uint8_t message[MSG_LEN] = "heeeeeeeelloooooooooooooooooo!";


	int ret = crypto_sign(sm, &sm_len, message, MSG_LEN, c_i.sk_i.ptr);
	PRINTF("RET %d\n", ret);
	PRINT_ARRAY("signature:",sm,sm_len);



	uint8_t message2[MSG_LEN];
	size_t msg_len = MSG_LEN;

	ret = crypto_sign_open(message2, &msg_len, sm, sm_len,c_i.pk_i.ptr);
	if(ret == 0){
		PRINT_MSG("Verify success!\n");
	}
	else{
		PRINT_MSG("verify fail!\n");
	}*/
	/*edhoc_initiator_run(&c_i, &cred_r_array, &err_msg, &PRK_out, tx, rx,
			    ead_process);

	PRINT_ARRAY("PRK_out", PRK_out.ptr, PRK_out.len);

	prk_out2exporter(SHA_256, &PRK_out, &prk_exporter);
	PRINT_ARRAY("prk_exporter", prk_exporter.ptr, prk_exporter.len);

	edhoc_exporter(SHA_256, OSCORE_MASTER_SECRET, &prk_exporter,
		       &oscore_master_secret);
	PRINT_ARRAY("OSCORE Master Secret", oscore_master_secret.ptr,
		    oscore_master_secret.len);

	edhoc_exporter(SHA_256, OSCORE_MASTER_SALT, &prk_exporter,
		       &oscore_master_salt);
	PRINT_ARRAY("OSCORE Master Salt", oscore_master_salt.ptr,
		    oscore_master_salt.len);*/

	//close(sockfd);
	return 0;
}


void main(void)
{
	//int r = internal_main();
	PRINT_MSG("MAIN\n");
	//k_sem_init(&my_sem, 0, 1);
	//k_sem_init(&my_sem_tx, 0, 2);
	//start_coap_client(&sockfd);
    //coap_client_init(&client, NULL);
	//txrx_edhoc(sockfd);
	edhoc_initiator_init();
	

	//coap_client_init(&client, NULL);
	//k_sem_give(&my_sem_init);
	/*if (r != 0) {
		printf("error during initiator run. Error code: %d\n", r);
	}*/
}
/* Create thread for EDHOC */
/*K_THREAD_DEFINE(edhoc_thread, //name
		50008, //stack_size
		edhoc_initiator_init, //entry_function
		NULL, NULL, NULL, //parameter1,parameter2,parameter3
		5, //priority
		0, //options
		20000); //delayz*/
```
